## arch/arm64/kvm/Kconfig
```kconfig
# SPDX-License-Identifier: GPL-2.0
#
# KVM configuration
#

source "virt/kvm/Kconfig"

menuconfig VIRTUALIZATION
	bool "Virtualization"
	help
	  Say Y here to get to see options for using your Linux host to run
	  other operating systems inside virtual machines (guests).
	  This option alone does not add any kernel code.

	  If you say N, all options in this submenu will be skipped and
	  disabled.

if VIRTUALIZATION

menuconfig KVM
	bool "Kernel-based Virtual Machine (KVM) support"
	select KVM_COMMON
	select KVM_GENERIC_HARDWARE_ENABLING
	select KVM_GENERIC_MMU_NOTIFIER
	select HAVE_KVM_CPU_RELAX_INTERCEPT
	select KVM_MMIO
	select KVM_GENERIC_DIRTYLOG_READ_PROTECT
	select VIRT_XFER_TO_GUEST_WORK
	select KVM_VFIO
	select HAVE_KVM_DIRTY_RING_ACQ_REL
	select NEED_KVM_DIRTY_RING_WITH_BITMAP
	select HAVE_KVM_MSI
	select HAVE_KVM_IRQCHIP
	select HAVE_KVM_IRQ_ROUTING
	select HAVE_KVM_IRQ_BYPASS
	select HAVE_KVM_READONLY_MEM
	select HAVE_KVM_VCPU_RUN_PID_CHANGE
	select SCHED_INFO
	select GUEST_PERF_EVENTS if PERF_EVENTS
	select KVM_GUEST_MEMFD
	help
	  Support hosting virtualized guest machines.

	  If unsure, say N.

if KVM

config PTDUMP_STAGE2_DEBUGFS
	bool "Present the stage-2 pagetables to debugfs"
	depends on DEBUG_KERNEL
	depends on DEBUG_FS
	depends on ARCH_HAS_PTDUMP
	select PTDUMP
	default n
	help
	  Say Y here if you want to show the stage-2 kernel pagetables
	  layout in a debugfs file. This information is only useful for kernel developers
	  who are working in architecture specific areas of the kernel.
	  It is probably not a good idea to enable this feature in a production
	  kernel.

	  If in doubt, say N.

config PKVM_MODULE_PATH
	string "Path to pKVM modules"
	default ""
	help
	  Directory where the pKVM modules are found. If empty, the modules
	  will be searched into the default path /lib/modules/<uname>.

config IOMMU_POOL_PAGES
	hex "Number of pages reserved for IOMMU pool"
	depends on KVM && IOMMU_SUPPORT
	default 0x0
	help
	  IOMMU pool is used with protected mode to allocated IOMMU drivers page tables.

config PKVM_GUEST_SELF_ASSIGN_DEVICE
	bool "Allow pKVM guest to self-assign passthrough devices via pviommu attach"
	depends on KVM
	default n
	help
	  When set, the first guest pviommu ATTACH_DEV hypercall for an
	  unassigned passthrough device causes EL2 to assign the device's
	  group to the calling VM. This lets a guest boot without pvmfw
	  having pre-assigned its devices, which is useful for hypervisor
	  development and debugging.

	  When unset, EL2 returns -EPERM unless pvmfw (or another trusted
	  entity) has already assigned the device to the calling VM
	  before the attach hypercall arrives.

	  If unsure, say N.

config PKVM_GUEST_TO_GUEST
	bool "pKVM guest-to-guest identity, messages and page sharing"
	depends on KVM
	default n
	help
	  Let protected VMs name each other, exchange short messages and
	  share pages through the pKVM hypervisor, without the host being
	  able to read what passes between them: a message travels in
	  registers and hypervisor memory, and the host never gains access to
	  a shared page. See Documentation/virt/kvm/arm/pkvm-guest-to-guest.rst.

	  In the hypervisor this adds vendor hypervisor calls 12 to 20 for
	  protected guests, advertised in ARM_SMCCC_KVM_FUNC_FEATURES:

	  - guest identity (14-16): a protected VM registers a 128-bit name
	    it chose itself, reads it back, and asks whether a name it was
	    given belongs to a live protected peer. A name authorises
	    nothing;
	  - messages (17, 18): four 64-bit words to a peer named by identity
	    and incarnation, through a one-slot mailbox at EL2. Delivery is
	    not guaranteed, and the receiver polls;
	  - page sharing (12, 13, 19, 20): an owner offers pages to a peer it
	    names, the peer maps them into its own address space, and either
	    side ends the share. A VM's teardown dismantles its shares at
	    EL2.

	  It also adds the page states guest-to-guest teardown needs, and
	  three self-checks at EL2 init (the reclaim decisions, the mailbox
	  and sharing) whose results the host kernel prints. If any of them
	  fails, none of the calls is advertised or answered.

	  In a guest kernel with CONFIG_ARM_PKVM_GUEST it adds /dev/pkvm-g2g
	  (include/uapi/linux/pkvm_g2g.h), which gives root in the guest
	  these calls through ioctl() and mmap(). The option lives under
	  CONFIG_KVM, which a guest kernel does not otherwise need.

	  Nothing in the kernel registers an identity on a guest's behalf
	  unless CONFIG_PKVM_GUEST_TO_GUEST_SELFTEST is set as well.

	  If unsure, say N.

menuconfig PKVM_DEBUG
	bool "Debug mode for Protected KVM hypervisor"
	help
	  Say Y here to enable the debug mode for the Protected KVM (pKVM)
	  hypervisor. Failure reports will BUG() in the hypervisor. This is
	  intended for local EL2 hypervisor development.

	  If unsure, say N.

if PKVM_DEBUG

config PKVM_STRICT_CHECKS
	bool "Additional checks in the Protected KVM hypervisor"
	default y
	help
	  Say Y here to add more checks into the Protected KVM hypervisor.
          Those checks have a slight performance cost and will BUG() on a
          failure. This is intended for EL2 hypervisor development.

config PKVM_SELFTESTS
	bool "Protected KVM hypervisor selftests"
	default y
	help
	  Say Y here to enable Protected KVM (pKVM) hypervisor selftests
	  during boot. Failure reports will panic the hypervisor. This is
	  intended for EL2 hypervisor development.

	  If unsure, say N.

config PKVM_DUMP_TRACE_ON_PANIC
	bool "Dump Protected KVM hypervisor trace buffer on panic"
	default y
	help
	   Say Y here to dump the content of the pKVM hypervisor on either
           hypervisor or host panic. In the case of a hyp panic, only the tail
           page is dumped. It only has an effect if the command line option
           hyp_trace_printk is set.

config PKVM_FTRACE
	bool "Protected KVM hypervisor function tracing"
	depends on FTRACE
	default y
	help
	  Say Y here to enable func and func_ret hypervisor tracing events.
	  Those events are raised whenever the hypervisor branch to a
	  function.

	  If unsure, Say N.

config PKVM_STACKTRACE
	bool "Protected KVM hypervisor stacktraces"
	depends on PKVM_DISABLE_STAGE2_ON_PANIC
	default y
	help
	  Say Y here to enable pKVM hypervisor stacktraces on hyp_panic()

	  If using protected nVHE mode, but cannot afford the associated
	  memory cost (less than 0.75 page per CPU) of pKVM stacktraces,
	  say N.

	  If unsure, or not using protected nVHE (pKVM), say N.

config PKVM_DISABLE_STAGE2_ON_PANIC
	bool "Disable the host stage-2 on panic"
	default n
	help
	  If panic occurs while the host lock is held and if, plagued by bad
	  luck the panic path triggers a host stage-2 memory abort, a lockup
	  would happen. The only way out is to disable the stage-2 page-table.
	  This however tamper the system security. This option should therefore
	  solely be enabled to debug specific issues.

	  Just say N.

endif # PKVM_DEBUG
endif # KVM
endif # VIRTUALIZATION
```

## drivers/memory/tegra/Kconfig
```kconfig
# SPDX-License-Identifier: GPL-2.0-only
config TEGRA_MC
	bool "NVIDIA Tegra Memory Controller support"
	default ARCH_TEGRA
	depends on ARCH_TEGRA || (COMPILE_TEST && COMMON_CLK)
	select INTERCONNECT
	help
	  This driver supports the Memory Controller (MC) hardware found on
	  NVIDIA Tegra SoCs.

if TEGRA_MC

config TEGRA20_EMC
	tristate "NVIDIA Tegra20 External Memory Controller driver"
	default ARCH_TEGRA_2x_SOC
	depends on ARCH_TEGRA_2x_SOC || COMPILE_TEST
	select DEVFREQ_GOV_SIMPLE_ONDEMAND
	select PM_DEVFREQ
	select DDR
	help
	  This driver is for the External Memory Controller (EMC) found on
	  Tegra20 chips. The EMC controls the external DRAM on the board.
	  This driver is required to change memory timings / clock rate for
	  external memory.

config TEGRA30_EMC
	tristate "NVIDIA Tegra30 External Memory Controller driver"
	default ARCH_TEGRA_3x_SOC
	depends on ARCH_TEGRA_3x_SOC || COMPILE_TEST
	select PM_OPP
	select DDR
	help
	  This driver is for the External Memory Controller (EMC) found on
	  Tegra30 chips. The EMC controls the external DRAM on the board.
	  This driver is required to change memory timings / clock rate for
	  external memory.

config TEGRA124_EMC
	tristate "NVIDIA Tegra124 External Memory Controller driver"
	default ARCH_TEGRA_124_SOC
	depends on ARCH_TEGRA_124_SOC || COMPILE_TEST
	select TEGRA124_CLK_EMC if ARCH_TEGRA
	select PM_OPP
	help
	  This driver is for the External Memory Controller (EMC) found on
	  Tegra124 chips. The EMC controls the external DRAM on the board.
	  This driver is required to change memory timings / clock rate for
	  external memory.

config TEGRA210_EMC_TABLE
	bool
	depends on ARCH_TEGRA_210_SOC || COMPILE_TEST

config TEGRA210_EMC
	tristate "NVIDIA Tegra210 External Memory Controller driver"
	depends on ARCH_TEGRA_210_SOC || COMPILE_TEST
	select TEGRA210_EMC_TABLE
	help
	  This driver is for the External Memory Controller (EMC) found on
	  Tegra210 chips. The EMC controls the external DRAM on the board.
	  This driver is required to change memory timings / clock rate for
	  external memory.

endif

config TEGRA_MC_PKVM
	bool "pKVM support for Tegra Memory Controller"
	depends on ARCH_TEGRA_234_SOC && ARM_SMMU_V2_PKVM
	default y if ARM_SMMU_V2_PKVM
	help
	  Enable pKVM hypervisor integration for Tegra Memory Controller.
	  This allows the EL2 hypervisor to trap and validate Stream ID
	  override writes, preventing devices from using unauthorized
	  Stream IDs to bypass IOMMU isolation.

	  This option automatically builds when ARM_SMMU_V2_PKVM is enabled
	  on Tegra234 platforms.
```

## drivers/tty/serial/pkvm-pl011/Kconfig
```kconfig
# SPDX-License-Identifier: GPL-2.0

config SERIAL_PKVM_PL011
	tristate "Protected KVM PL011 UART"
	depends on ARM64 && KVM
	select SERIAL_CORE
	help
	  Enable UART in pKVM hypervisor.

config SERIAL_PKVM_PL011_BASE_PHYS
	hex "PL011 base physical address"
	depends on SERIAL_PKVM_PL011
	default 0x09000000

config SERIAL_PKVM_PL011_UARTFR
	hex
	depends on SERIAL_PKVM_PL011
	default 0x18

config SERIAL_PKVM_PL011_UARTTX
	hex
	depends on SERIAL_PKVM_PL011
	default 0x0

config SERIAL_PKVM_PL011_BUSY
	hex
	depends on SERIAL_PKVM_PL011
	default 0x3

config SERIAL_PKVM_PL011_FULL
	hex
	depends on SERIAL_PKVM_PL011
	default 0x5
```
